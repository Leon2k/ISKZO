#include "../74HC595/74hc595.h"

void M74HC595_ClearData(void) {
	HAL_GPIO_WritePin(GPIOA, M74HC595_SCLR_NOT, GPIO_PIN_RESET);
	HAL_GPIO_WritePin(GPIOA, M74HC595_SCLR_NOT, GPIO_PIN_SET);
}

void M74HC595_EnableData(void) {
	HAL_GPIO_WritePin(M74HC595_PORT, M74HC595_G_NOT, GPIO_PIN_RESET);
}

void M74HC595_WriteData(const unsigned char data0, const unsigned char data1, const unsigned char data2) {
unsigned char i;
	for(i=0; i < 8; i++) {

		if (((1 << i) & data2)) HAL_GPIO_WritePin(M74HC595_PORT, M74HC595_SI, GPIO_PIN_RESET);
		else HAL_GPIO_WritePin(M74HC595_PORT, M74HC595_SI, GPIO_PIN_SET);

		HAL_GPIO_WritePin(M74HC595_PORT, M74HC595_SCK, GPIO_PIN_RESET);
		HAL_GPIO_WritePin(M74HC595_PORT, M74HC595_SCK, GPIO_PIN_SET);
	}
	HAL_GPIO_WritePin(M74HC595_PORT, M74HC595_RCK, GPIO_PIN_RESET);
	HAL_GPIO_WritePin(M74HC595_PORT, M74HC595_RCK, GPIO_PIN_SET);
	for(i=0; i < 8; i++) {
			if (((1 << i) & data1)) HAL_GPIO_WritePin(M74HC595_PORT, M74HC595_SI, GPIO_PIN_RESET);
			else HAL_GPIO_WritePin(M74HC595_PORT, M74HC595_SI, GPIO_PIN_SET);

			HAL_GPIO_WritePin(M74HC595_PORT, M74HC595_SCK, GPIO_PIN_RESET);
			HAL_GPIO_WritePin(M74HC595_PORT, M74HC595_SCK, GPIO_PIN_SET);
	}
	HAL_GPIO_WritePin(M74HC595_PORT, M74HC595_RCK, GPIO_PIN_RESET);
	HAL_GPIO_WritePin(M74HC595_PORT, M74HC595_RCK, GPIO_PIN_SET);
	for(i=0; i < 8; i++) {
			if (((1 << i) & data0)) HAL_GPIO_WritePin(M74HC595_PORT, M74HC595_SI, GPIO_PIN_RESET);
			else HAL_GPIO_WritePin(M74HC595_PORT, M74HC595_SI, GPIO_PIN_SET);

			HAL_GPIO_WritePin(M74HC595_PORT, M74HC595_SCK, GPIO_PIN_RESET);
			HAL_GPIO_WritePin(M74HC595_PORT, M74HC595_SCK, GPIO_PIN_SET);
	}
	HAL_GPIO_WritePin(M74HC595_PORT, M74HC595_RCK, GPIO_PIN_RESET);
	HAL_GPIO_WritePin(M74HC595_PORT, M74HC595_RCK, GPIO_PIN_SET);

	M74HC595_EnableData();
}
